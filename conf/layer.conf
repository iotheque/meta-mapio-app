## conf/layer.conf
```bitbake
# We have a conf and classes directory, append to BBPATH
BBPATH .= ":${LAYERDIR}"

# We have a recipes directory containing .bb and .bbappend files, add to BBFILES
BBFILES += "${LAYERDIR}/recipes*/*/*.bb \
            ${LAYERDIR}/recipes*/*/*.bbappend"

BBFILE_COLLECTIONS += "mapio-app"
BBFILE_PATTERN_mapio-app := "^${LAYERDIR}/"
BBFILE_PRIORITY_mapio-app = "10"

LAYERDEPENDS_mapio-app = "raspberrypi"

LAYERSERIES_COMPAT_mapio-app = "kirkstone"
```
